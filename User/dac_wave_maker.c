#include "stm32f10x.h"
#include "dac.h"
#include "math.h"

/*******************************************************************************
	正弦波数据，12bit，1个周期128个点
	波形由PA4输出, PA4 用作 DAC_OUT1， DAC的参考电压 = 3.3V
*******************************************************************************/
const uint16_t g_SineWave128[] = {
	2047 ,
	2147 ,
	2248 ,
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	1846 ,
	1947
};

uint16_t g_Wave[128];
 /*******************************************************************************
*	函数名: SetupWaveType
*	输  入:	无
*	输  出:	无
*	功能说明：设置是产生正弦波还是产生方波
*			  
*******************************************************************************/
void SetupWaveType(uint8_t _type)
{
	/*
		计算波形幅度。
		DAC寄存器最大值 4096 对应3.3V

		我们期望获得2V的幅度，系数 = 0.606
		4096 * 0.606 = 2482
	*/
	TIM_Cmd(TIM6, DISABLE);
	switch (_type)
	{
		case WAVE_SIN:	/* 正弦波 */
			{
				uint32_t i;

				for (i = 0; i < 128; i++)
				{
					/* 调整正弦波幅度 */
					//g_Wave[i] = g_SineWave128[i]*0.606;
					g_Wave[i] = 2048+1024*sin(2*3.1415926f*127*i/128); 
				}

			}
			break;

		case WAVE_RECT:	/* 方波 */
			{
				uint32_t i;

				for (i = 0; i < 64; i++)
				{
					g_Wave[i] = 0;
				}

				for (i = 0; i < 64; i++)
				{
					g_Wave[i] = 2482;
				}
			}
			break;
	}
    TIM_Cmd(TIM6, ENABLE);
}


